## drivers/media/platform/mtk-isp/Kconfig
```kconfig
config MTK_SENINF
	tristate "Mediatek sensor interface driver"
	depends on VIDEO_V4L2 && VIDEO_V4L2_SUBDEV_API
	depends on MEDIA_CAMERA_SUPPORT
	depends on ARCH_MEDIATEK || COMPILE_TEST
	select V4L2_FWNODE
	default n
	---help---
	  This driver provides a MIPI CSI-2 receiver interface to connect
	  an external camera module with Mediatek's MT8183 ISP SoC. It is
	  able to handle multiple cameras at the same time.
```

## drivers/misc/mediatek/Kconfig
```kconfig
source "drivers/misc/mediatek/gpu/gpu_rgx/Kconfig"
source "drivers/misc/mediatek/usb11/Kconfig"
```

## drivers/net/ethernet/mediatek/Kconfig
```kconfig
# SPDX-License-Identifier: GPL-2.0-only
config NET_VENDOR_MEDIATEK
	bool "MediaTek ethernet driver"
	depends on ARCH_MEDIATEK || SOC_MT7621 || SOC_MT7620
	---help---
	  If you have a Mediatek SoC with ethernet, say Y.

if NET_VENDOR_MEDIATEK

config NET_MEDIATEK_SOC
	tristate "MediaTek SoC Gigabit Ethernet support"
	select PHYLINK
	---help---
	  This driver supports the gigabit ethernet MACs in the
	  MediaTek SoC family.

config NET_MEDIATEK_STAR
	tristate "Mediatek STAR MAC ethernet support"
	select MII
	---help---
	  If you have a network (Ethernet) chipset belonging to this class,
	  say Y.

	  To compile this driver as a module, choose Y here. The module
	  will be called star_mac.

endif #NET_VENDOR_MEDIATEK
```
