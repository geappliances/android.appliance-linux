## Documentation/devicetree/bindings/leds/leds-apa102.txt
```
Shiji Lighting - apa102 LED driver
-------------------------------------------------

This LED is a three color RGB LED with 32 levels brightness adjustment that can
be cascaded so that multiple LEDs can be set with a single command.

Required properties:
- compatible: "shiji,apa102"

Property rules described in Documentation/devicetree/bindings/spi/spi-bus.txt
apply. In particular, "reg" and "spi-max-frequency" properties must be given.

LED sub-node properties:
- reg :
	the led number. Must be contiguously allocated between 0 and the maximum number of led minus 1
- label :
	see Documentation/devicetree/bindings/leds/common.txt
- linux,default-trigger : (optional)
	see Documentation/devicetree/bindings/leds/common.txt

Example
-------

led-controller@0 {
	compatible = "shiji,apa102";
	reg = <0>;
	spi-max-frequency = <1000000>;
	#address-cells = <1>;
	#size-cells = <0>;
	led@0 {
		reg = <0>;
		label = "led1";
	};

	led@1 {
		reg = <1>;
		label = "led2";
	};

	led@2 {
		reg = <2>;
		label = "led3";
	};

	led@3 {
		reg = <3>;
		label = "led4";
	};

	led@4 {
		reg = <4>;
		label = "led5";
	};

	led@5 {
		reg = <5>;
		label = "led6";
	};

	led@6 {
		reg = <6>;
		label = "led7";
	};

	...
};
```

## Documentation/devicetree/bindings/media/mediatek-camctl.yaml
```yaml
# SPDX-License-Identifier: (GPL-2.0-Only OR BSD-2-Clause)
%YAML 1.2
---
$id: http://devicetree.org/schemas/media/mediatek-camctl.yaml#
$schema: http://devicetree.org/meta-schemas/core.yaml#

title: Mediatek CAMCTL Device Tree Bindings

maintainers:
  - Florian Sylvestre <fsylvestre@baylibre.com>

description: |
  The CAMCTL is an ISP connected to the SENINF CSI-2 receivers.
  The CAMCTL allows raw image direct transfert into memory with DMA support.

properties:
  compatible:
    const: mediatek,mt8167-cam

  reg:
    minItems: 1

  interrupts:
    maxItems: 1

  power-domains:
    maxItems: 1

  clocks:
    items:
      - description: larb1_smi clock
      - description: cam_smi clock
      - description: cam_cam clock

  clock-names:
    items:
      - const: img_larb1_smi
      - const: img_cam_smi
      - const: img_cam_cam

  iommus:
    items:
      - const: M4U_PORT_CAM_IMGO

  mediatek,larb:
    items:
      - const: larb1

  ports:
    $ref: /schemas/graph.yaml#/properties/ports

    properties:
      port@0:
        $ref: /schemas/graph.yaml#/properties/port
        unevaluatedProperties: false
        description: connection point for camctl

        patternProperties:
          endpoint:
            $ref: video-interfaces.yaml#
            unevaluatedProperties: false

    required:
      - port@0

required:
  - compatible
  - interrupts
  - clocks
  - clock-names
  - power-domains
  - iommus
  - mediatek,larb
  - ports

additionalProperties: false

examples:
  - |
    cam: cam@0x15004000 {
        compatible = "mediatek,mt8167-cam";
        reg = <0 0x15004000 0 0x1000>;
        interrupts = <GIC_SPI 180 IRQ_TYPE_LEVEL_LOW>;
        clocks = <&imgsys CLK_IMG_LARB1_SMI>,
             <&imgsys CLK_IMG_CAM_SMI>,
             <&imgsys CLK_IMG_CAM_CAM>;
        clock-names =  "img_larb1_smi",
                  "img_cam_smi",
                  "img_cam_cam";
        iommus = <&iommu M4U_PORT_CAM_IMGO>;
        mediatek,larb = <&larb1>;
        power-domains = <&scpsys MT8167_POWER_DOMAIN_ISP>;
        status = "disabled";

        ports {
            #address-cells = <1>;
            #size-cells = <0>;
            port@0 {
                reg = <0>;
                cam_endpoint: endpoint {
                    remote-endpoint =
                          <&seninf_cam_endpoint>;
                };
            };
        };
    };
...
```

## Documentation/devicetree/bindings/media/mediatek-mipicsi-camsv.txt
```
* Mediatek MIPI-CSI2 receiver camsv

Mediatek MIPI-CSI2 receiver camsv transfer data to DRAM in Mediatek SoCs

These node are refer by mipicsi

Required properties:
- reg : physical base address of the mipicsi receiver registers and length of
  memory mapped region.
- clocks: device clocks, see
  Documentation/devicetree/bindings/clock/clock-bindings.txt for details.
- interrupts : interrupt number to the interrupt controller.

Example:
	seninf1_mux_camsv0: seninf_mux_camsv@15002100 {
		reg = <0 0x15002120 0 0x40>,
		      <0 0x15004000 0 0x1000>;
		clocks = <&imgsys CLK_IMG_CAM_SV_EN>;
		interrupts = <GIC_SPI 222 IRQ_TYPE_LEVEL_LOW>;
	};

	seninf2_mux_camsv1: seninf_mux_camsv@15002500 {
		reg = <0 0x15002520 0 0x40>,
		      <0 0x15005000 0 0x1000>;
		clocks = <&imgsys CLK_IMG_CAM_SV_EN>;
		interrupts = <GIC_SPI 223 IRQ_TYPE_LEVEL_LOW>;
	};

	seninf3_mux_camsv2: seninf_mux_camsv@15002900 {
		reg = <0 0x15002920 0 0x40>,
		      <0 0x15006000 0 0x1000>;
		clocks = <&imgsys CLK_IMG_CAM_SV1_EN>;
		interrupts = <GIC_SPI 268 IRQ_TYPE_LEVEL_LOW>;
	};

	seninf4_mux_camsv3: seninf_mux_camsv@15002D00 {
		reg = <0 0x15002D20 0 0x40>,
		      <0 0x15007000 0 0x1000>;
		clocks = <&imgsys CLK_IMG_CAM_SV1_EN>;
		interrupts = <GIC_SPI 269 IRQ_TYPE_LEVEL_LOW>;
	};

	seninf5_mux_camsv4: seninf_mux_camsv@15003100 {
		reg = <0 0x15003120 0 0x40>,
		      <0 0x15008000 0 0x1000>;
		clocks = <&imgsys CLK_IMG_CAM_SV2_EN>;
		interrupts = <GIC_SPI 270 IRQ_TYPE_LEVEL_LOW>;
	};

	seninf6_mux_camsv5: seninf_mux_camsv@15003500 {
		reg = <0 0x15003520 0 0x40>,
		      <0 0x15009000 0 0x1000>;
		clocks = <&imgsys CLK_IMG_CAM_SV2_EN>;
		interrupts = <GIC_SPI 271 IRQ_TYPE_LEVEL_LOW>;
	};
```

## Documentation/devicetree/bindings/media/mediatek-mipicsi-common.txt
```
* Mediatek MIPI-CSI2 receiver common

Mediatek MIPI-CSI2 receiver is the MIPI Signal capture hardware present in Mediatek SoCs

Required properties:
- compatible: should be "mediatek,mt2712-mipicsi-common"
- reg : physical base address of the mipicsi receiver registers and length of
  memory mapped region.
- clocks: device clocks, see
  Documentation/devicetree/bindings/clock/clock-bindings.txt for details.


Example:
	mipicsi: mipicsi@15002000 {
		compatible = "mediatek,mt2712-mipicsi-common", "syscon";
		reg = <0 0x15002000 0 0x10>;
		clocks = <&imgsys CLK_IMG_SENINF_CAM_EN>,
			 <&imgsys CLK_IMG_SENINF_SCAM_EN>;
	};
```

## Documentation/devicetree/bindings/media/mediatek-mipicsi.txt
```
* Mediatek MIPI-CSI2 receiver

Mediatek MIPI-CSI2 receiver is the MIPI Signal capture hardware present in Mediatek SoCs

Required properties:
- compatible: should be "mediatek,mt8167-mipicsi"
- reg : physical base address of the mipicsi receiver registers and length of
  memory mapped region.
- power-domains: a phandle to the power domain, see
  Documentation/devicetree/bindings/power/power_domain.txt for details.
- mediatek,larb: must contain the local arbiters in the current Socs, see
  Documentation/devicetree/bindings/memory-controllers/mediatek,smi-larb.txt
  for details.
- iommus: should point to the respective IOMMU block with master port as
  argument, see Documentation/devicetree/bindings/iommu/mediatek,iommu.txt
  for details.
- mediatek,seninf_mux_camsv: seninf_mux_camsv the data go through of the mipicsi port.
- mediatek,mipicsiid: the id of the mipicsi port, there is only one port for mt8167
- mediatek,mipicsi: the common component of the mipicsi port

Example:
	mipicsi0: mipicsi@10011800 {
		compatible = "mediatek,mt8167-mipicsi";
		mediatek,mipicsi = <&mipicsi>;
		iommus = <&iommu0 M4U_PORT_CAM_IMGO>;
		mediatek,larb = <&larb1>;
		power-domains = <&scpsys MT8167_POWER_DOMAIN_ISP>;

		mediatek,seninf_mux_camsv = <&seninf1_mux_camsv0>;
		reg = <0 0x10011800 0 0x60>,
			  <0 0x15008100 0 0x4>,
			  <0 0x15008300 0 0x100>;

		mediatek,mipicsiid = <0>;
	};
```

## Documentation/devicetree/bindings/media/mediatek-seninf-dphy.yaml
```yaml
# SPDX-License-Identifier: (GPL-2.0-Only OR BSD-2-Clause)
%YAML 1.2
---
$id: http://devicetree.org/schemas/media/mediatek-seninf-dphy.yaml#
$schema: http://devicetree.org/meta-schemas/core.yaml#

title: Mediatek Sensor Interface MIPI C/D-PHY Device Tree Bindings

maintainers:
  - Louis Kuo <louis.kuo@mediatek.com>

description: |
  The SENINF C/D-PHY is a set of C-PHY and D-PHY connected to the SENINF CSI-2
  receivers. The number of PHYs depend on the SoC model.

properties:
  compatible:
    const: mediatek,mt8183-mipi-dphy

  reg:
    minItems: 1

  '#phy-cells':
    const: 1

required:
  - compatible
  - reg
  - '#phy-cells'

additionalProperties: false

examples:
  - |
    mipi_dphy: phy@11c80000 {
        compatible = "mediatek,mt8183-mipi_dphy";
        reg = <0x11c80000 0x6000>;
        #phy-cells = <1>;
    };
...
```

## Documentation/devicetree/bindings/media/mediatek-seninf.yaml
```yaml
# SPDX-License-Identifier: (GPL-2.0-Only OR BSD-2-Clause)
%YAML 1.2
---
$id: http://devicetree.org/schemas/media/mediatek-seninf.yaml#
$schema: http://devicetree.org/meta-schemas/core.yaml#

title: Mediatek Sensor Interface (CSI) Device Tree Bindings

maintainers:
  - Louis Kuo <louis.kuo@mediatek.com>

description: |
  Seninf MIPI-CSI2 host driver is a HW camera interface controller. It support
  a widely adopted, simple, high-speed protocol primarily intended for
  point-to-point image and video transmission between cameras and host devices.

properties:
  compatible:
    const: mediatek,mt8183-seninf

  reg:
    minItems: 1

  interrupts:
    maxItems: 1

  power-domains:
    maxItems: 1

  clocks:
    items:
      - description: Seninf camsys clock
      - description: Seninf top mux clock

  clock-names:
    items:
      - const: cam_seninf
      - const: top_mux_seninf

  phys:
    items:
      - description: Seninf mipi dphy

  phy-names:
    items:
      - const: seninf

  # See ./video-interfaces.txt for details
  ports:
    type: object
    additionalProperties: false

    properties:
      port@0:
        type: object
        description: connection point for sensor at port 0
        additionalProperties: false

        properties:
          reg:
            const: 0

        patternProperties:
          endpoint:
            type: object
            additionalProperties: false

            properties:
              data-lanes:
                minItems: 1
                maxItems: 4

              remote-endpoint: true

      port@1:
        type: object
        description: connection point for sensor at port 1
        additionalProperties: false

        properties:
          reg:
            const: 1

        patternProperties:
          endpoint:
            type: object
            additionalProperties: false

            properties:
              data-lanes:
                minItems: 1
                maxItems: 4

              remote-endpoint: true

      port@4:
        type: object
        description: connection point for camsys
        additionalProperties: false

        properties:
          reg:
            const: 4

        patternProperties:
          endpoint:
            type: object
            additionalProperties: false

            properties:
              remote-endpoint: true

    required:
      - port@0
      - port@1
      - port@4

required:
  - compatible
  - interrupts
  - clocks
  - clock-names
  - power-domains
  - ports

additionalProperties: false

examples:
  - |
    #include <dt-bindings/clock/mt8183-clk.h>
    #include <dt-bindings/interrupt-controller/irq.h>
    #include <dt-bindings/interrupt-controller/arm-gic.h>
    #include <dt-bindings/power/mt8183-power.h>

    seninf: seninf@1a040000 {
        compatible = "mediatek,mt8183-seninf";
        reg = <0x1a040000 0x8000>;
        interrupts = <GIC_SPI 251 IRQ_TYPE_LEVEL_LOW>;
        power-domains = <&scpsys MT8183_POWER_DOMAIN_CAM>;
        clocks = <&camsys CLK_CAM_SENINF>,
                 <&topckgen CLK_TOP_MUX_SENINF>;
        clock-names = "cam_seninf", "top_mux_seninf";
        phys = <&mipi_dphy 0>;
        phy-names = "seninf";

        ports {
            #address-cells = <1>;
            #size-cells = <0>;

            port@0 {
                reg = <0>;
                mipi_in_bcam: endpoint {
                    data-lanes = <0 1 3 4>;
                    remote-endpoint = <&bcam_out>;
                };
            };

            port@1 {
                reg = <1>;
                mipi_in_fcam: endpoint {
                    data-lanes = <1>;
                    remote-endpoint = <&fcam_out>;
                };
            };

            port@4 {
                reg = <4>;
                seninf_camisp_endpoint: endpoint {
                    remote-endpoint = <&camisp_endpoint>;
                };
            };
        };
    };

    mipi_dphy: phy@11c80000 {
        compatible = "mediatek,mt8183-mipi_dphy";
        reg = <0x11c80000 0x6000>;
        #phy-cells = <1>;
    };

    i2c2: i2c@11009000 {
        reg = <0x11009000 0x1000>;
        clock-frequency = <400000>;
        #address-cells = <1>;
        #size-cells = <0>;

        wcam: camera@36 {
            compatible = "ovti,ov5695";
            reg = <0x36>;

            port {
                bcam_out: endpoint {
                    remote-endpoint = <&mipi_in_bcam>;
                    data-lanes = <0 1 3 4>;
                };
            };
        };
    };

    i2c4: i2c@11008000 {
        reg = <0x11008000 0x1000>;
        clock-frequency = <400000>;
        #address-cells = <1>;
        #size-cells = <0>;

        ucam: camera@3c {
            compatible = "ovti,ov2685";
            reg = <0x3c>;

            port {
                fcam_out: endpoint {
                    remote-endpoint = <&mipi_in_fcam>;
                    data-lanes = <1>;
                };
            };
        };
    };
...
```
