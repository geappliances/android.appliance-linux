// SPDX-License-Identifier: GPL-2.0
/*
 * Copyright (c) 2025 BayLibre, SAS.
 * Author: Julien Masson <jmasson@baylibre.com>
 */

/dts-v1/;
/plugin/;

#include "mt8188-android-dsi.dtsi"

&dsi0 {
	panel@0 {
		compatible = "startek,kd070fhfid078";
		backlight = <&backlight_lcd1>;
        };
};

&hdmi0_dai_link {
	status = "okay";
};
