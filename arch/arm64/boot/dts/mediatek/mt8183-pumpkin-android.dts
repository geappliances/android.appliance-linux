/dts-v1/;
/plugin/;

&reserved_memory {
	ramoops@0x4FF00000 {
		compatible = "ramoops";
		reg = <0x0 0x4FF00000 0x0 0x00100000>;
		record-size = <0x8000>;
		console-size = <0x8000>;
		ftrace-size = <0x0>;
		pmsg-size = <0x8000>;
	};
};
