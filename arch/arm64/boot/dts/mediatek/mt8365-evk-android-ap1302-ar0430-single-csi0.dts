// SPDX-License-Identifier: GPL-2.0
/*
 * Copyright (c) 2021 Baylibre, SAS
 * Author: Florian Sylvestre <florian.sylvestre@baylibre.com>
 */

#include "mt8365-evk-android-ap1302-ar0430-dual.dtsi"


&i2c3 {
	camera@3c {
		status = "disabled";
	};
};

&camsv2 {
		status = "disabled";
};
